## config/west.yml
```yaml
manifest:
  remotes:
    - name: Xoffio
      url-base: https://github.com/Xoffio/zmk.git
  projects:
    - name: zmk
      remote: Xoffio
      revision: xo-status-fx
      import: app/west.yml
```
